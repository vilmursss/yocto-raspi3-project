## conf/bblayers.conf
```bitbake
POKY_BBLAYERS_CONF_VERSION = "2"

ROOT_DIR = "${@os.path.abspath(os.path.join(d.getVar('TOPDIR'), '..'))}"

BBPATH = "${TOPDIR}"
BBFILES ?= ""

BBLAYERS ?= " \
  ${ROOT_DIR}/poky/meta \
  ${ROOT_DIR}/poky/meta-poky \
  ${ROOT_DIR}/poky/meta-yocto-bsp \
  ${ROOT_DIR}/meta-openembedded/meta-oe \
  ${ROOT_DIR}/meta-openembedded/meta-multimedia \
  ${ROOT_DIR}/meta-openembedded/meta-networking \
  ${ROOT_DIR}/meta-openembedded/meta-python \
  ${ROOT_DIR}/meta-raspberrypi \
"
```

## conf/local.conf
```bitbake
MACHINE = "raspberrypi3"
DISTRO ?= "poky"

PACKAGE_CLASSES ?= "package_rpm"

EXTRA_IMAGE_FEATURES ?= "debug-tweaks"

IMAGE_INSTALL:append = " vim"
IMAGE_INSTALL:append = " dropbear"
IMAGE_INSTALL:append = " led-ctrl-device"

CONF_VERSION = "2"
```

## meta-ledapp/conf/layer.conf
```bitbake
# We have a conf and classes directory, add to BBPATH
BBPATH .= ":${LAYERDIR}"

# We have recipes-* directories, add to BBFILES
BBFILES += "${LAYERDIR}/recipes-*/*/*.bb \
            ${LAYERDIR}/recipes-*/*/*.bbappend"

BBFILE_COLLECTIONS += "meta-ledapp"
BBFILE_PATTERN_meta-ledapp := "^${LAYERDIR}/"
BBFILE_PRIORITY_meta-ledapp = "6"
# Specify the compatible layer versions

LAYERSERIES_COMPAT_meta-ledapp = "warrior zeus dunfell gatesgarth hardknott honister kirkstone langdale"
```
